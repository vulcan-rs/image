## external/Config.in
```kconfig
source "$BR2_EXTERNAL_VULCAN_PATH/package/vulcan/Config.in"
source "$BR2_EXTERNAL_VULCAN_PATH/package/portal/Config.in"
```

## external/configs/vulcan_x86_64_defconfig
```kconfig
BR2_x86_64=y
BR2_CPAN_MIRROR="http://cpan.metacpan.org"
BR2_CCACHE=y
BR2_TARGET_GENERIC_HOSTNAME="vulcan"
BR2_TARGET_GENERIC_ISSUE="Welcome to Vulcan"
BR2_INIT_SYSTEMD=y
BR2_LINUX_KERNEL=y
BR2_LINUX_KERNEL_DEFCONFIG="x86_64"
BR2_PACKAGE_GIT=y
BR2_PACKAGE_ZSH=y
BR2_PACKAGE_HTOP=y
BR2_PACKAGE_BAT=y
BR2_PACKAGE_NANO=y
BR2_TARGET_ROOTFS_EXT2=y
BR2_TARGET_ROOTFS_EXT2_4=y
BR2_TARGET_ROOTFS_EXT2_SIZE="512M"
# BR2_TARGET_ROOTFS_TAR is not set
BR2_PACKAGE_VULCAN=y
BR2_PACKAGE_PORTAL=y
```

## external/package/portal/Config.in
```kconfig
config BR2_PACKAGE_PORTAL
	bool "vulcan"
	depends on BR2_PACKAGE_HOST_RUSTC_TARGET_ARCH_SUPPORTS
	select BR2_PACKAGE_HOST_RUSTC
	help
	  Portal is a DNS server written in pure Rust.

	  https://github.com/portal-rs/portal
```

## external/package/vulcan/Config.in
```kconfig
config BR2_PACKAGE_VULCAN
	bool "vulcan"
	depends on BR2_PACKAGE_HOST_RUSTC_TARGET_ARCH_SUPPORTS
	select BR2_PACKAGE_HOST_RUSTC
	help
	  A Rust based router / firewall.

	  https://github.com/vulcan-rs/vulcan
```
